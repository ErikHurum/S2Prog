//////////////////////////////////////////////////////////////////////////////
//
// Contains resource definitions of Atmel ATmega1281
//
// File version: $Revision$
//
// The '_..X_' prefix is used by C-SPY as an indication that the label should
// not be displayed in the dissassembly window.
//

//////////////////////////////////////////////////////////////////////////////
// Code (flash) segments
-D_..X_INTVEC_SIZE=CC                  // 51 Interrupt vectors * 4 bytes each
-D_..X_FLASH_END=1FFFF                 // End of flash memory
-D_..X_FLASH_NEND=FFFF                 // End of near flash memory

//////////////////////////////////////////////////////////////////////////////
// Data (SRAM, external ROM or external NV RAM) memory
-D_..X_SRAM_BASE=200                   // Start of ram memory
-D_..X_SRAM_TBASE=0                    // Start of tiny ram memory
-D_..X_SRAM_TSIZE=0                    // Size of the tiny ram memory
-D_..X_SRAM_END=21FF                   // End of ram memory
//////////////////////////////////////////////////////////////////////////////
// Internal EEPROM
-D_..X_EEPROM_START=0
-D_..X_EEPROM_END=FFF                  // End of eeprom memory
-Z(CODE)CODE=60-1FFFF

