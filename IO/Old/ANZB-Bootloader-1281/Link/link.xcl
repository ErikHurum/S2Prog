//////////////////////////////////////////////////////////////////////////////
//
// Contains resource definitions at Atmel ATmega1280
//
// File version: $Revision: 5724 $
//
// The '_..X_' prefix is used by C-SPY as an indication that the label should
// not be displayed in the dissassembly window.
//

//////////////////////////////////////////////////////////////////////////////
// Code (flash) segments
-D_..X_INTVEC_SIZE=E4   // 4 bytes * 57 vectors
-D_..X_FLASH_NEND=FFFF  // End of near flash memory
-D_..X_FLASH_END=1FFFF  // End of flash memory

//////////////////////////////////////////////////////////////////////////////
// Data (SRAM, external ROM or external NV RAM) memory
-D_..X_SRAM_BASE=200    // Start of ram memory
-D_..X_SRAM_TBASE=0     // Start of tiny ram memory
-D_..X_SRAM_TSIZE=0     //Size of the tiny ram memory
-D_..X_SRAM_END=21FF    // End of ram memory

-Z(CODE)INTVEC=1E000-1E0E3
-H1895 -h(CODE)1E000-1E0E3

//////////////////////////////////////////////////////////////////////////////
// Internal EEPROM
-D_..X_EEPROM_END=FFF   // End of eeprom memory
-D_..X_EEPROM_START=0

-Z(CODE)NEAR_F,HUGE_F,SWITCH,INITTAB,DIFUNCT,CODE=1E0E4-1FFFF
-Z(FARCODE)FAR_F=1E0E4-1FFFF

-Z(DATA)NEAR_I,NEAR_Z,FAR_I,FAR_Z=_..X_SRAM_BASE-_..X_SRAM_END
-Z(CODE)NEAR_ID=1E0E4-1FFFF
-Z(DATA)NEAR_C,FAR_C=1E0E4-1FFFF

-Z(DATA)RSTACK+_..X_RSTACK_SIZE=_..X_SRAM_BASE-_..X_SRAM_END
-Z(DATA)CSTACK+_..X_CSTACK_SIZE=_..X_SRAM_BASE-_..X_SRAM_END
