// T32 Mon Jun 25 02:33:20 2001

 B::
 
 TOOLBAR ON
 STATUSBAR ON
 WINPAGE.RESET
 
 WINCLEAR
 WINPOS 0.0 0.0 76. 25. 13. 1. W000
 WINTABS 10. 10. 25. 62.
 Data.List
 
 WINPOS 79.875 0.0 48. 29. 0. 0. W001
 Register /SpotLight
 
 WINPOS 80.25 31.9375 48. 5. 0. 0. W002
 CD.PEDIT txu_s3c2410_reset.cmm
 
 WINPAGE.SELECT P000     
 
 ENDDO
