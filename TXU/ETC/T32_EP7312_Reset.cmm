reset
sys.d
sys.u
screen.off
TASK.CONFIG embos
MENU.ReProgram embos

