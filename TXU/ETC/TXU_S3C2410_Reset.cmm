reset
sys.d
sys.u
screen.off
TASK.CONFIG embos
MENU.ReProgram embos
DATA.SET 0x03ff0000 %LONG 0x03FFFFA0
DATA.SET 0x03ff3010 %LONG 0x0000003e
DATA.SET 0x03ff3014 %LONG 0x18860030
DATA.SET 0x03ff3018 %LONG 0x00400010
DATA.SET 0x03ff301c %LONG 0x00801010
DATA.SET 0x03ff3020 %LONG 0x08018020
DATA.SET 0x03ff3024 %LONG 0x0a020040
DATA.SET 0x03ff3028 %LONG 0x0c028040
DATA.SET 0x03ff303c %LONG 0x9c218360


