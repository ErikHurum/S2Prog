//*********************************************************************
//*                SEGGER MICROCONTROLLER SYSTEME GmbH                *
//*        Solutions for real time microcontroller applications       *
//*********************************************************************
//*                                                                   *
//*      (C) 2005- 2007 SEGGER Microcontroller Systeme GmbH           *
//*                  www.segger.com                                   *
//*                                                                   *
//*********************************************************************
//
//---------------------------------------------------------------------
//File   : TMPA910_SDRAM.xcl
//Purpose: Linker file for TMPA and IAR embedded workbench V4
//         Execution in SDRAM, loaded to original address.
//         May be used to generate Debug-applications which run SDRAM
//-------- END-OF-HEADER ----------------------------------------------
//

-DROMSTART=40000000     // SDRAM start address    
-DROM_SIZE=2000000      // Program area is limited to 32MB
-DROMEND=(ROMSTART+ROM_SIZE-1)

-DRAMSTART=(0x40000000+ROM_SIZE)  // External SDRAM, ROMSIZE reserved for Flash image
-DRAM_SIZE=(0x4000000-ROM_SIZE)   // 64MB - reserved size
-DRAMEND=(RAMSTART+RAM_SIZE-1)

-DIRAMSTART=F8002000    // Internal SRAM, NOT remapped
-DIRAMEND=F800FFFF

-D_CSTACK_SIZE=(80*4)
-D_IRQ_STACK_SIZE=(3*(4*7)+8)  // Nesting level * (Size per interrupt) + margin for alignement

-carm

//************************************************
// Address range for reset and exception
// vectors (INTVEC).
// The vector area is 32 bytes,
// an additional 32 bytes is allocated for the
// constant table used by ldr PC in cstartup.s79.
//************************************************
-Z(CODE)INTVEC=ROMSTART-ROMEND

//************************************************
// Startup code and exception routines (ICODE).
//************************************************
-Z(CODE)ICODE=ROMSTART-ROMEND
-Z(CODE)DIFUNCT,SWITAB,CODE,CODE_ID=ROMSTART-ROMEND

//************************************************
// Various constants and initializers.
//************************************************
-Z(CONST)INITTAB,DATA_ID,DATA_C,CHECKSUM=ROMSTART-ROMEND

//************************************************
// PROGRAM_END has to be located behind all code 
// and const segments by linker
//************************************************
-Z(CONST)PROGRAM_END=ROMSTART-ROMEND

//************************************************
// Data segments.
//************************************************
-Z(DATA)DATA_I,DATA_Z,DATA_N,CODE_I=RAMSTART-RAMEND
-Z(DATA)CSTACK+_CSTACK_SIZE,IRQ_STACK+_IRQ_STACK_SIZE=IRAMSTART-IRAMEND
-QCODE_I=CODE_ID



