//*********************************************************************
//*                SEGGER MICROCONTROLLER SYSTEME GmbH                *
//*        Solutions for real time microcontroller applications       *
//*********************************************************************
//*                                                                   *
//*      (C) 2005- 2007 SEGGER Microcontroller Systeme GmbH           *
//*                  www.segger.com                                   *
//*                                                                   *
//*********************************************************************
//
//---------------------------------------------------------------------
//File   : AT91SAM9261_iRAM.xcl
//Purpose: Linker file for AT91SAM9261 and IAR embedded workbench V4
//-------- END-OF-HEADER ----------------------------------------------
//

-DROMSTART=00000000
-DROMEND=00027FFF
-DRAMSTART=00000000
-DRAMEND=00027FFF
-D_CSTACK_SIZE=(80*4)
-D_IRQ_STACK_SIZE=(3*(4*7)+8)  // Nesting level * (Size per interrupt) + margin for alignement

-carm


//************************************************
// Address range for reset and exception
// vectors (INTVEC).
// The vector area is 32 bytes,
// an additional 32 bytes is allocated for the
// constant table used by ldr PC in cstartup.s79.
//************************************************
-Z(CODE)INTVEC=ROMSTART-(ROMSTART+FF)

//************************************************
// Startup code and exception routines (ICODE).
//************************************************
-Z(CODE)ICODE,DIFUNCT,SWITAB,CODE,CODE_ID=ROMSTART-ROMEND

//************************************************
// Various constants and initializers.
//************************************************
-Z(CONST)INITTAB,DATA_ID,DATA_C,CHECKSUM=ROMSTART-ROMEND

//************************************************
// PROGRAM_END has to be located behind all code 
// and const segments by linker
//************************************************
-Z(CONST)PROGRAM_END=ROMSTART-ROMEND


//************************************************
// Data segments.
//************************************************
-Z(DATA)DATA_I,DATA_Z,DATA_N,CODE_I,CSTACK+_CSTACK_SIZE,IRQ_STACK+_IRQ_STACK_SIZE=RAMSTART-RAMEND
-QCODE_I=CODE_ID



